## sdk_root_dir/kernel/liteos/liteos_v208.6.0_b017/Huawei_LiteOS/targets/Kconfig.aiot
```kconfig
config LOSCFG_PLATFORM
    string
    default "tr5310"            if LOSCFG_PLATFORM_TR5310
    default "tr5310p"            if LOSCFG_PLATFORM_TR5310P
    default "tr5310pa"           if LOSCFG_PLATFORM_TR5310PA
    default "tr5312l"            if LOSCFG_PLATFORM_TR5312L
    default "tr5312"            if LOSCFG_PLATFORM_TR5312
    default "tr5316"            if LOSCFG_PLATFORM_TR5316
    default "tr5336"            if LOSCFG_PLATFORM_TR5336
    default "suqin_app"       if LOSCFG_PLATFORM_SUQIN_APP
    default "sushik_app"      if LOSCFG_PLATFORM_SUSHIK_APP
    default "socmn1"          if LOSCFG_PLATFORM_SOCMN1
    default "sw39_bt"         if LOSCFG_PLATFORM_SW39_BT

choice
    prompt "Board"
    depends on LOSCFG_FAMILY_AIOT
    default LOSCFG_PLATFORM_TR5312

config LOSCFG_PLATFORM_TR5310
    bool "tr5310"
    select LOSCFG_ARCH_RISCV_ISA_F
    select LOSCFG_ARCH_LINXCORE_131
    select LOSCFG_TIMER_VENDOR
    select LOSCFG_DRIVERS_UART_VENDOR
    select LOSCFG_USING_BOARD_LD
    select LOSCFG_USING_BOARD_RESET_VECTOR
    select LOSCFG_DRIVERS_USB_DEVICE_NO_DRIVER_BASE

config LOSCFG_PLATFORM_TR5310P
    bool "tr5310p"
    select LOSCFG_ARCH_RISCV_ISA_F
    select LOSCFG_ARCH_LINXCORE_131
    select LOSCFG_TIMER_VENDOR
    select LOSCFG_DRIVERS_UART_VENDOR
    select LOSCFG_USING_BOARD_LD
    select LOSCFG_USING_BOARD_RESET_VECTOR
    select LOSCFG_DRIVERS_USB_DEVICE_NO_DRIVER_BASE

config LOSCFG_PLATFORM_TR5310PA
    bool "tr5310pa"
    select LOSCFG_ARCH_RISCV_ISA_F
    select LOSCFG_ARCH_LINXCORE_131
    select LOSCFG_TIMER_VENDOR
    select LOSCFG_DRIVERS_UART_VENDOR
    select LOSCFG_USING_BOARD_LD
    select LOSCFG_USING_BOARD_RESET_VECTOR
    select LOSCFG_DRIVERS_USB_DEVICE_NO_DRIVER_BASE

config LOSCFG_PLATFORM_TR5312L
    bool "tr5312l"
    select LOSCFG_ARCH_RISCV_ISA_F
    select LOSCFG_ARCH_LINXCORE_131
    select LOSCFG_TIMER_VENDOR
    select LOSCFG_DRIVERS_UART_VENDOR
    select LOSCFG_USING_BOARD_LD
    select LOSCFG_USING_BOARD_RESET_VECTOR
    select LOSCFG_DRIVERS_USB_DEVICE_NO_DRIVER_BASE

config LOSCFG_PLATFORM_TR5312
    bool "tr5312"
    select LOSCFG_ARCH_LINXCORE_131
    select LOSCFG_ARCH_RISCV_RV32IMC
    select LOSCFG_RISCV_HIMIDEERV200_PLIC
    select LOSCFG_TIMER_VENDOR
    select LOSCFG_DRIVERS_UART_VENDOR
    select LOSCFG_USING_BOARD_LD
    select LOSCFG_ARCH_RISCV_RV32F
    select LOSCFG_ARCH_RISCV32
    select LOSCFG_USING_BOARD_RESET_VECTOR

config LOSCFG_PLATFORM_TR5316
    bool "tr5316"
    select LOSCFG_ARCH_RISCV_ISA_F
    select LOSCFG_ARCH_LINXCORE_131
    select LOSCFG_TIMER_VENDOR
    select LOSCFG_DRIVERS_UART_VENDOR
    select LOSCFG_USING_BOARD_LD
    select LOSCFG_USING_BOARD_RESET_VECTOR
    select LOSCFG_DRIVERS_USB_DEVICE_NO_DRIVER_BASE

config LOSCFG_PLATFORM_TR5336
    bool "tr5336"
    select LOSCFG_ARCH_RISCV_RV32IMC
    select LOSCFG_ARCH_LINXCORE_131
    select LOSCFG_RISCV_HIMIDEERV200_PLIC
    select LOSCFG_TIMER_VENDOR
    select LOSCFG_DRIVERS_UART_VENDOR
    select LOSCFG_USING_BOARD_LD
    select LOSCFG_ARCH_RISCV_RV32F
    select LOSCFG_ARCH_RISCV32
    select LOSCFG_USING_BOARD_RESET_VECTOR

config LOSCFG_PLATFORM_SUQIN_APP
    bool "suqin_app"
    select LOSCFG_ARCH_LINXCORE_170
    select LOSCFG_ARCH_RISCV_RV32F
    select LOSCFG_LCMP_CUSTOM_INST16_EXTENSIONS
    select LOSCFG_LCMP_CUSTOM_INST16_SUB_EXTENSIONS
    select LOSCFG_LCMP_CUSTOM_INST32_EXTENSIONS
    select LOSCFG_TIMER_VENDOR
    select LOSCFG_DRIVERS_UART_VENDOR
    select LOSCFG_USING_BOARD_LD
    select LOSCFG_USING_BOARD_RESET_VECTOR

config LOSCFG_PLATFORM_SOCMN1
    bool "socmn1"
    select LOSCFG_ARCH_CORTEX_M7
    select LOSCFG_ARCH_FPU_VFP_DP
    select LOSCFG_CORTEX_M_SYSTICK
    select LOSCFG_USING_BOARD_LD
    select LOSCFG_DRIVERS_UART_VENDOR

config LOSCFG_PLATFORM_SW39_BT
    bool "sw39_bt"
    select LOSCFG_ARCH_LINXCORE_170
    select LOSCFG_ARCH_RISCV_RV32F
    select LOSCFG_LCMP_CUSTOM_INST16_EXTENSIONS
    select LOSCFG_LCMP_CUSTOM_INST16_SUB_EXTENSIONS
    select LOSCFG_LCMP_CUSTOM_INST32_EXTENSIONS
    select LOSCFG_TIMER_VENDOR
    select LOSCFG_DRIVERS_UART_VENDOR
    select LOSCFG_USING_BOARD_LD
    select LOSCFG_USING_BOARD_RESET_VECTOR

endchoice
```

## sdk_root_dir/middleware/chips/Kconfig
```kconfig
#===============================================================================
# @brief    Kconfig file.
# Copyright (c) Triductor. 2022-2023. All rights reserved.
#===============================================================================

choice
    prompt "Choose Chip"

config MIDDLEWARE_CHIP_TRSWGXX
    bool "trswgxx"

config MIDDLEWARE_CHIP_TR5336
    bool "tr5336"

endchoice

if MIDDLEWARE_CHIP_TRSWGXX
menu "Chip Configurations for trswgxx"
    comment "Config trswgxx"
    osource "middleware/chips/trswgxx/Kconfig"
endmenu
endif

if MIDDLEWARE_CHIP_TR5336
menu "Chip Configurations for tr5336"
    comment "Config tr5336"
    osource "middleware/chips/tr5336/Kconfig"
endmenu
endif
```
