## sdk_root_dir/application/samples/peripheral/i2s/Kconfig
```kconfig
#===============================================================================
# @brief    Kconfig file.
# Copyright (c) Triductor. 2023-2023. All rights reserved.
#===============================================================================
config SAMPLE_SUPPORT_I2S_MASTER
    bool
    prompt "Support I2S Master Sample."
    default n
    depends on SAMPLE_SUPPORT_I2S
    help
        This option means support I2S Master Sample.

config I2S_MASTER_BUS_ID
    int
    prompt "Choose I2S master bus id."
    depends on SAMPLE_SUPPORT_I2S_MASTER
    default 0

config I2S_CLK_MASTER_PIN
    int
    prompt "Choose I2S CLK master pin."
    depends on SAMPLE_SUPPORT_I2S_MASTER
    default 33

config I2S_WS_MASTER_PIN
    int
    prompt "Choose I2S WS master pin."
    depends on SAMPLE_SUPPORT_I2S_MASTER
    default 34

config I2S_DO_MASTER_PIN
    int
    prompt "Choose I2S DO master pin."
    depends on SAMPLE_SUPPORT_I2S_MASTER
    default 35

config I2S_DI_MASTER_PIN
    int
    prompt "Choose I2S DI master pin."
    depends on SAMPLE_SUPPORT_I2S_MASTER
    default 36

config I2S_MASTER_CLK_PIN_MODE
    int
    prompt "Choose I2S master CLK pin mode."
    depends on SAMPLE_SUPPORT_I2S_MASTER
    default 1

config I2S_MASTER_WS_PIN_MODE
    int
    prompt "Choose I2S master WS pin mode."
    depends on SAMPLE_SUPPORT_I2S_MASTER
    default 1

config I2S_MASTER_DO_PIN_MODE
    int
    prompt "Choose I2S master DO pin mode."
    depends on SAMPLE_SUPPORT_I2S_MASTER
    default 1

config I2S_MASTER_DI_PIN_MODE
    int
    prompt "Choose I2S master DI pin mode."
    depends on SAMPLE_SUPPORT_I2S_MASTER
    default 1

config SAMPLE_SUPPORT_I2S_SLAVE
    bool
    prompt "Support I2S Slave Sample."
    default n
    depends on SAMPLE_SUPPORT_I2S
    help
        This option means support I2S Slave Sample.

config I2S_SLAVE_BUS_ID
    int
    prompt "Choose I2S slave bus id."
    depends on SAMPLE_SUPPORT_I2S_SLAVE
    default 0

config I2S_CLK_SLAVE_PIN
    int
    prompt "Choose I2S CLK slave pin."
    depends on SAMPLE_SUPPORT_I2S_SLAVE
    default 33

config I2S_WS_SLAVE_PIN
    int
    prompt "Choose I2S WS slave pin."
    depends on SAMPLE_SUPPORT_I2S_SLAVE
    default 34

config I2S_DO_SLAVE_PIN
    int
    prompt "Choose I2S DO slave pin."
    depends on SAMPLE_SUPPORT_I2S_SLAVE
    default 35

config I2S_DI_SLAVE_PIN
    int
    prompt "Choose I2S DI slave pin."
    depends on SAMPLE_SUPPORT_I2S_SLAVE
    default 36

config I2S_SLAVE_CLK_PIN_MODE
    int
    prompt "Choose I2S slave CLK pin mode."
    depends on SAMPLE_SUPPORT_I2S_SLAVE
    default 1

config I2S_SLAVE_WS_PIN_MODE
    int
    prompt "Choose I2S slave WS pin mode."
    depends on SAMPLE_SUPPORT_I2S_SLAVE
    default 1

config I2S_SLAVE_DO_PIN_MODE
    int
    prompt "Choose I2S slave DO pin mode."
    depends on SAMPLE_SUPPORT_I2S_SLAVE
    default 1

config I2S_SLAVE_DI_PIN_MODE
    int
    prompt "Choose I2S slave DI pin mode."
    depends on SAMPLE_SUPPORT_I2S_SLAVE
    default 1

config I2S_TRANSFER_LEN
    int
    prompt "Choose I2S transfer length."
    depends on SAMPLE_SUPPORT_I2S
    default 32
```

## sdk_root_dir/application/samples/peripheral/lpc/Kconfig
```kconfig
#===============================================================================
# @brief    Kconfig file.
# Copyright (c) Triductor. 2024-2024. All rights reserved.
#===============================================================================
config LPC_GPIO_WAKEUP_PIN
    int
    prompt "Choose lpc gpio wakeup pin."
    depends on SAMPLE_SUPPORT_LPC
    default 0
```

## sdk_root_dir/application/samples/peripheral/rtc/Kconfig
```kconfig
#===============================================================================
# @brief    Kconfig file.
# Copyright (c) Triductor. 2023-2023. All rights reserved.
#===============================================================================
config RTC_INDEX
    int
    prompt "Choose RTC Test Index."
    depends on SAMPLE_SUPPORT_RTC
    default 2

config RTC_IRQN
    int
    prompt "Choose RTC Test Irq Number."
    depends on SAMPLE_SUPPORT_RTC
    default 51

config RTC_PRIO
    int
    prompt "Choose RTC Test Priority."
    depends on SAMPLE_SUPPORT_RTC
    default 1
```

## sdk_root_dir/application/samples/peripheral/uart/Kconfig
```kconfig
#===============================================================================
# @brief    Kconfig file.
# Copyright (c) Triductor. 2023-2023. All rights reserved.
#===============================================================================
config UART_BUS_ID
    int
    prompt "Choose UART bus id."
    depends on SAMPLE_SUPPORT_UART
    default 1

config UART_SUPPORT_INT_MODE
    bool
    prompt "UART support interrupt mode."
    depends on SAMPLE_SUPPORT_UART
    default n

config UART_TRANSFER_SIZE
    int
    prompt "Config UART transfer size."
    depends on SAMPLE_SUPPORT_UART
    default 64
```

## sdk_root_dir/application/samples/products/Kconfig
```kconfig
#===============================================================================
# @brief    Kconfig file.
# Copyright (c) Triductor. 2023-2023. All rights reserved.
#===============================================================================
config SAMPLE_SUPPORT_BLE_UART
    bool
    prompt "Support BLE UART sample."
    default n
    depends on ENABLE_PRODUCTS_SAMPLE
    help
        This option means support BLE UART Sample.

if SAMPLE_SUPPORT_BLE_UART
menu "BLE UART Sample Configuration"
    osource "application/samples/products/ble_uart/Kconfig"
endmenu
endif

config SAMPLE_SUPPORT_RCU
    bool
    prompt "Support RCU sample."
    default n
    depends on ENABLE_PRODUCTS_SAMPLE
    help
        This option means support RCU Sample.

if SAMPLE_SUPPORT_RCU
menu "rcu Sample Configuration"
    osource "application/samples/products/rcu/Kconfig"
endmenu
endif

config SAMPLE_SUPPORT_SLE_OTA_DONGLE
    bool
    prompt "Support sle ota dongle sample."
    default n
    depends on ENABLE_PRODUCTS_SAMPLE
    help
        This option means support sle ota dongle Sample.

if SAMPLE_SUPPORT_SLE_OTA_DONGLE
menu "sle ota dongle Sample Configuration"
    osource "application/samples/products/sle_ota_dongle/Kconfig"
endmenu
endif

config SAMPLE_SUPPORT_SLE_MULTI_CONN
    bool
    prompt "Support SLE Multi Connections sample."
    default n
    depends on ENABLE_PRODUCTS_SAMPLE
    help
        This option means support SLE Multi Connections Sample.

if SAMPLE_SUPPORT_SLE_MULTI_CONN
menu "SLE Multi Connections Sample Configuration"
    osource "application/samples/products/sle_multi_conn/Kconfig"
endmenu
endif

config SAMPLE_SUPPORT_SLE_UART
    bool
    prompt "Support SLE UART sample."
    default n
    depends on ENABLE_PRODUCTS_SAMPLE
    help
        This option means support SLE UART Sample.

if SAMPLE_SUPPORT_SLE_UART
menu "SLE UART Sample Configuration"
    osource "application/samples/products/sle_uart/Kconfig"
endmenu
endif

config SAMPLE_SUPPORT_LOWPOWER
    bool
    prompt "Support lowpower sample."
    default n
    depends on ENABLE_PRODUCTS_SAMPLE
    select PM_SYS_SUPPORT
    help
        This option means support lowpower Sample.

config SAMPLE_SUPPORT_SLE_LOWPOWER
    bool
    prompt "Support SLE_LOWPOWER Sample."
    default n
    depends on ENABLE_PRODUCTS_SAMPLE
    help
        This option means support SLE_LOWPOWER Sample.

if SAMPLE_SUPPORT_SLE_LOWPOWER
menu "SLE_LOWPOWER Configuration"
    osource "application/samples/products/sle_lowpower/Kconfig"
endmenu
endif

config SAMPLE_SUPPORT_SLE_MULTI_CONN_PERFORMANCE
    bool
    prompt "Support SLE_MULTI_CONN_PERFORMANCE Sample."
    default n
    depends on ENABLE_PRODUCTS_SAMPLE
    help
        This option means support SLE_MULTI_CONN_PERFORMANCE Sample.

if SAMPLE_SUPPORT_SLE_MULTI_CONN_PERFORMANCE
menu "SLE_MULTI_CONN_PERFORMANCE Configuration"
    osource "application/samples/products/sle_multi_conn_performance/Kconfig"
endmenu
endif
```

## sdk_root_dir/drivers/chips/Kconfig
```kconfig
#===============================================================================
# @brief    Kconfig file.
# Copyright (c) Triductor. 2022-2022. All rights reserved.
#===============================================================================

choice
    prompt "Choose Chip"
    default CHIP_TR531X
config CHIP_TRSWGXX
    bool "trswgxx"

config CHIP_TR5336
    bool "tr5336"

config CHIP_TR531X
    bool "tr531x"

config CHIP_SW39
    bool "sw39"

config CHIP_FHL2
    bool "fenghuolunv200"
endchoice

if CHIP_TRSWGXX
menu "Chip Configurations for trswgxx"
    comment "Config trswgxx"
    osource "drivers/chips/trswgxx/Kconfig"
endmenu
endif

if CHIP_TR5336
menu "Chip Configurations for tr5336"
    comment "Config tr5336"
    osource "drivers/chips/tr5336/Kconfig"
endmenu
endif

if CHIP_TR531X
menu "Chip Configurations for tr531x"
    comment "tr531x chipset resource config"
    osource "drivers/chips/tr531x/Kconfig"
endmenu
endif

if CHIP_SW39
menu "Chip Configurations for sw39"
    comment "sw39 chipset resource config"
    osource "drivers/chips/sw39/Kconfig"
endmenu
endif

if CHIP_FHL2
menu "Chip Configurations for fenghuolunv200"
    comment "fenghuolunv200 chipset resource config"
    osource "drivers/chips/fhl2/boot/commonboot/Kconfig"
endmenu
endif
```

## sdk_root_dir/drivers/chips/tr531x/Kconfig
```kconfig
#===============================================================================
# @brief    Kconfig file.
# Copyright (c) Triductor. 2022-2022. All rights reserved.
#===============================================================================
config I2C_BUS_MAX_NUM
    int
    prompt "I2C Max Bus num, the BS2x chip supports a maximum of 2 buses."
    range 1 2
    default 1
    depends on DRIVER_SUPPORT_I2C

config SPI_BUS_MAX_NUM
    int
    prompt "SPI Max Bus num, the BS2x chip supports a maximum of 3 buses."
    range 1 3
    default 2
    depends on DRIVER_SUPPORT_SPI

config SUPPORT_LOG_THREAD
    bool
    prompt "CREATE LOG MAIN THREAD."
    default y

config SPI_BUS0_CLK_PIN
    int
    prompt "SPI clk pin of bus0."
    default 0
    depends on DRIVER_SUPPORT_SPI

config SPI_BUS0_CS_PIN
    int
    prompt "SPI cs pin of bus0."
    default 1
    depends on DRIVER_SUPPORT_SPI

config SPI_BUS0_DI_PIN
    int
    prompt "SPI data input pin of bus0."
    default 2
    depends on DRIVER_SUPPORT_SPI

config SPI_BUS0_DO_PIN
    int
    prompt "SPI data output pin of bus0."
    default 3
    depends on DRIVER_SUPPORT_SPI

config SPI_BUS1_CLK_PIN
    int
    prompt "SPI clk pin of bus1."
    default 4
    depends on DRIVER_SUPPORT_SPI

config SPI_BUS1_CS_PIN
    int
    prompt "SPI cs pin of bus1."
    default 5
    depends on DRIVER_SUPPORT_SPI

config SPI_BUS1_DI_PIN
    int
    prompt "SPI data input pin of bus1."
    default 6
    depends on DRIVER_SUPPORT_SPI

config SPI_BUS1_DO_PIN
    int
    prompt "SPI data output pin of bus1."
    default 7
    depends on DRIVER_SUPPORT_SPI

config SPI_BUS2_CLK_PIN
    int
    prompt "SPI clk pin of bus2."
    default 8
    depends on DRIVER_SUPPORT_SPI

config SPI_BUS2_CS_PIN
    int
    prompt "SPI cs pin of bus2."
    default 9
    depends on DRIVER_SUPPORT_SPI

config SPI_BUS2_DI_PIN
    int
    prompt "SPI data input pin of bus2."
    default 10
    depends on DRIVER_SUPPORT_SPI

config SPI_BUS2_DO_PIN
    int
    prompt "SPI data output pin of bus2."
    default 11
    depends on DRIVER_SUPPORT_SPI

config PM_CLOCK_SUPPORT_SFC_HIGH_FREQ
    bool
    prompt "SFC enable high freq"
    default n
    depends on DRIVER_SUPPORT_SFC
```

## sdk_root_dir/drivers/drivers/driver/dma/Kconfig
```kconfig
#===============================================================================
# @brief    Kconfig file.
# Copyright (c) Triductor. 2022-2022. All rights reserved.
#===============================================================================
config DMA_SUPPORT_LLI
    bool
    prompt "DMA support lli."
    default y
    depends on DRIVER_SUPPORT_DMA

config DMA_SUPPORT_CIRCULAR_LLI
    bool
    prompt "DMA support circular lli."
    default n
    depends on DMA_SUPPORT_LLI

config DMA_SUPPORT_LPM
    bool
    prompt "DMA support low power mode."
    default y
    depends on DRIVER_SUPPORT_DMA

config DMA_SUPPORT_CLOCK
    bool
    prompt "DMA choose clock."
    default n
    depends on DRIVER_SUPPORT_DMA

config DMA_SUPPORT_QUERY_REGS
    bool
    prompt "DMA support query regs values."
    default n
    depends on DRIVER_SUPPORT_DMA
```

## sdk_root_dir/drivers/drivers/driver/gpio/Kconfig
```kconfig
#===============================================================================
# @brief    Kconfig file.
# Copyright (c) Triductor. 2022-2022. All rights reserved.
#===============================================================================

config GPIO_SUPPORT_LPM
    bool
    prompt "GPIO support low power mode, supend and reusme."
    default y
    depends on DRIVER_SUPPORT_GPIO

config GPIO_SELECT_CORE
    bool
    prompt "GPIO support choose to select core."
    default n
    depends on DRIVER_SUPPORT_GPIO
```

## sdk_root_dir/drivers/drivers/driver/pinmux/Kconfig
```kconfig
#===============================================================================
# @brief    Kconfig file.
# Copyright (c) Triductor. 2023-2023. All rights reserved.
#===============================================================================
config PINCTRL_SUPPORT_LPM
    bool
    prompt "PINCTRL support low power mode, supend and reusme."
    default n
    depends on DRIVER_SUPPORT_PINCTRL
```

## sdk_root_dir/drivers/drivers/driver/pwm/Kconfig
```kconfig
#===============================================================================
# @brief    Kconfig file.
# Copyright (c) Triductor. 2022-2022. All rights reserved.
#===============================================================================
config PWM_SUPPORT_LPM
    bool
    prompt "PWM support low power mode, supend and reusme."
    default n
    depends on DRIVER_SUPPORT_PWM
```

## sdk_root_dir/drivers/drivers/driver/systick/Kconfig
```kconfig
#===============================================================================
# @brief    Kconfig file.
# Copyright (c) Triductor. 2023-2023. All rights reserved.
#===============================================================================
config SYSTICK_SUPPORT_LPM
    bool
    prompt "Systick support low power mode, supend and reusme."
    default n
    depends on DRIVER_SUPPORT_SYSTICK
```

## sdk_root_dir/drivers/drivers/driver/tcxo/Kconfig
```kconfig
#===============================================================================
# @brief    Kconfig file.
# Copyright (c) Triductor. 2023-2023. All rights reserved.
#===============================================================================
config TCXO_SUPPORT_LPM
    bool
    prompt "TCXO support low power mode, supend and reusme."
    default n
    depends on DRIVER_SUPPORT_TCXO
```
