## sdk_root_dir/drivers/drivers/driver/uart/Kconfig
```kconfig
#===============================================================================
# @brief    Kconfig file.
# Copyright (c) Triductor. 2022-2022. All rights reserved.
#===============================================================================
config UART_BAUD_RATE_DIV_8
    bool
    prompt "UART Baud rate div 8."
    default y
    depends on DRIVER_SUPPORT_UART

config UART_SUPPORT_TX
    bool
    prompt "UART support TX."
    default y
    depends on DRIVER_SUPPORT_UART

config UART_SUPPORT_TX_INT
    bool
    prompt "UART support TX interrupt mode."
    default y
    depends on DRIVER_SUPPORT_UART

config UART_SUPPORT_RX
    bool
    prompt "UART support RX."
    default y
    depends on DRIVER_SUPPORT_UART

config UART_SUPPORT_RX_THREAD
    bool
    prompt "UART support RX thread."
    default n
    depends on UART_SUPPORT_RX

config UART_SUPPORT_RX_THREAD_STACK_SIZE
    int
    prompt "UART RX thread stack size."
    default 1024
    depends on UART_SUPPORT_RX_THREAD

config UART_SUPPORT_RX_THREAD_BUFFER_SIZE
    int
    prompt "UART RX thread heap size."
    default 8192
    depends on UART_SUPPORT_RX_THREAD

config UART_SUPPORT_RX_THREAD_PRIORITY
    int
    prompt "UART RX thread priority."
    default 1
    depends on UART_SUPPORT_RX_THREAD

config UART_SUPPORT_RX_THREAD_DEBUG
    bool
    prompt "UART support RX thread debug."
    default n
    depends on UART_SUPPORT_RX_THREAD

config UART_SUPPORT_DMA
    bool
    prompt "UART support dma."
    default y
    depends on DRIVER_SUPPORT_UART
    select DRIVER_SUPPORT_DMA

config UART_SUPPORT_SEND_IN_DMA_ISR
    bool
    prompt "UART Support send in dma isr"
    default n
    depends on DRIVER_SUPPORT_DMA

config UART_SUPPORT_INT_TRIGGER_DMA
    bool
    prompt "UART support rx interrupt trigger dma."
    default y
    depends on UART_SUPPORT_DMA

config UART_SUPPORT_FLOW_CTRL
    bool
    prompt "UART support flow control."
    default n
    depends on DRIVER_SUPPORT_UART

config UART_SUPPORT_HW_FLOW_CTRL
    bool
    prompt "UART support hardware flow control."
    default n
    depends on UART_SUPPORT_FLOW_CTRL

config UART_SUPPORT_SW_FLOW_CTRL
    bool
    prompt "UART support software flow control."
    default n
    depends on UART_SUPPORT_FLOW_CTRL

config UART_SUPPORT_LPM
    bool
    prompt "UART support low power mode, supend and reusme."
    default y
    depends on DRIVER_SUPPORT_UART

config UART_FIFO_DEPTH
    int
    prompt "UART FIFO depth."
    range 64 128
    default 64
    depends on DRIVER_SUPPORT_UART

config UART_SUPPORT_LPC
    bool
    prompt "UART support low power control, control power and clock."
    default n
    depends on DRIVER_SUPPORT_UART

config UART_MULTI_CORE_RESUME
    bool
    prompt "UART support low power resume skip some port for multi-core."
    default n
    depends on UART_SUPPORT_LPM

config UART_NOT_SUPPORT_RX_CONDITON_SIZE_OPTIMIZE
    bool
    prompt "UART don't support rx condition size optimization."
    default n
    depends on UART_SUPPORT_RX

config UART_SUPPORT_QUERY_REGS
    bool
    prompt "UART support query regs values."
    default n
    depends on DRIVER_SUPPORT_UART

config UART_L0_TX_PIN
    int
    prompt "UART config uart L0 tx pin."
    default 19
    depends on DRIVER_SUPPORT_UART

config UART_L0_RX_PIN
    int
    prompt "UART config uart L0 rx pin."
    default 20
    depends on DRIVER_SUPPORT_UART

config UART_H0_TX_PIN
    int
    prompt "UART config uart H0 tx pin."
    default 17
    depends on DRIVER_SUPPORT_UART

config UART_H0_RX_PIN
    int
    prompt "UART config uart H0 rx pin."
    default 18
    depends on DRIVER_SUPPORT_UART

config UART_H0_CTS_PIN
    int
    prompt "UART config uart h0 cts pin, which is not used by default"
    default 100
    depends on UART_SUPPORT_FLOW_CTRL

config UART_H0_RTS_PIN
    int
    prompt "UART config uart h0 rts pin, which is not used by default"
    default 100
    depends on UART_SUPPORT_FLOW_CTRL
```

## sdk_root_dir/drivers/drivers/hal/pwm/Kconfig
```kconfig
#===============================================================================
# @brief    Kconfig file.
# Copyright (c) Triductor. 2022-2022. All rights reserved.
#===============================================================================
config PWM_USING_V150
    bool
    prompt "Using PWM V150."
    default n
    depends on DRIVER_SUPPORT_PWM

config PWM_USING_V151
    bool
    prompt "Using PWM V151."
    default n
    depends on DRIVER_SUPPORT_PWM

config PWM_PRELOAD
    bool
    prompt "Using PWM preload."
    default n
    depends on PWM_USING_V151

config PWM_GROUP_NUM
    int
    prompt "The number of groups in PWM."
    range 1 16
    default 6
    depends on DRIVER_SUPPORT_PWM

config PWM_CHANNEL_NUM
    int
    prompt "PWM channel number."
    default 6
    depends on DRIVER_SUPPORT_PWM

config PWM_SUPPORT_TIME_32BIT
    bool
    prompt "Support time 32bit."
    default n
    depends on PWM_USING_V151
```

## sdk_root_dir/drivers/drivers/hal/spi/Kconfig
```kconfig
#===============================================================================
# @brief    Kconfig file.
# Copyright (c) Triductor. 2022-2022. All rights reserved.
#===============================================================================
config SPI_USING_V100
    bool
    prompt "Using SPI V100."
    default y
    depends on DRIVER_SUPPORT_SPI

config SPI_USING_V151
    bool
    prompt "Using SPI V151."
    default y
    depends on DRIVER_SUPPORT_SPI

config SPI_USING_V151_100
    bool
    prompt "Using SPI V151_100."
    default n
    depends on DRIVER_SUPPORT_SPI
```

## sdk_root_dir/drivers/drivers/hal/systick/Kconfig
```kconfig
#===============================================================================
# @brief    Kconfig file.
# Copyright (c) Triductor. 2024-2024. All rights reserved.
#===============================================================================
config SYSTICK_WITH_TWO_DATA_REGS
    bool
    prompt "Systick calculated with two data registers."
    default n
    depends on DRIVER_SUPPORT_SYSTICK
```

## sdk_root_dir/drivers/drivers/hal/tcxo/Kconfig
```kconfig
#===============================================================================
# @brief    Kconfig file.
# Copyright (c) Triductor. 2024-2024. All rights reserved.
#===============================================================================
config TCXO_WITH_TWO_DATA_REGS
    bool
    prompt "TCXO calculated with two data registers."
    default n
    depends on DRIVER_SUPPORT_TCXO
```
